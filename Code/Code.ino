#include <Wire.h>
#include <Adafruit_GFX.h>
#include <Adafruit_SSD1306.h>

// Define the screen size
#define SCREEN_WIDTH 128
#define SCREEN_HEIGHT 64

// Initialize the OLED display
Adafruit_SSD1306 display(SCREEN_WIDTH, SCREEN_HEIGHT, &Wire, -1);

// 'Connect computer icon', 128x48px
const unsigned char Connect_computer_icon [] PROGMEM = {
	0x00, 0x00, 0x00, 0x00, 0x00, 0x00, 0x00, 0x00, 0x00, 0x00, 0x00, 0x00, 0x00, 0x00, 0x00, 0x00, 
	0x00, 0x00, 0x00, 0x00, 0x00, 0x00, 0x00, 0x00, 0x00, 0x00, 0x00, 0x00, 0x00, 0x00, 0x00, 0x00, 
	0x00, 0x00, 0x00, 0x00, 0x00, 0x00, 0x00, 0x00, 0x00, 0x00, 0x00, 0x00, 0x00, 0x00, 0x00, 0x00, 
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	0x00, 0x00, 0x00, 0x00, 0x00, 0x00, 0x00, 0x00, 0x00, 0x00, 0x00, 0x00, 0x00, 0x00, 0x00, 0x00
};

// Array of all bitmaps for convenience. (Total bytes used to store images in PROGMEM = 784)
const int  allArray_LEN = 1;
const unsigned char*  allArray[1] = {
	 Connect_computer_icon
};


// Define buffer size and chunk size
#define BUFFER_SIZE 256  // Adjust to the actual bitmap width
#define CHUNK_SIZE 32    // Must match the chunk size used in Python

// Define buffer and index
byte buffer[BUFFER_SIZE];
int index = 0;
int line = 0;

void setup() {
  Serial.begin(115200);  // Initialize serial communication at 9600 baud rate

  // Initialize OLED display
  if (!display.begin(SSD1306_SWITCHCAPVCC, 0x3C)) {
    Serial.println(F("SSD1306 allocation failed"));
    for (;;); // Infinite loop
  }
  display.clearDisplay();
  display.setTextColor(WHITE);
  display.setCursor(0, 0);
  display.print(" LAUNCH 'CBPaint.exe'");
  display.drawBitmap(0, 10, Connect_computer_icon, 128, 48, WHITE);
  display.setCursor(0, 56);
  display.display();
}

void loop() {
  if (Serial.available() >= CHUNK_SIZE) {
    // Read data into buffer
    for (int i = 0; i < CHUNK_SIZE; i++) {
      buffer[i] = Serial.read();
    }

    display.drawBitmap(0, line, buffer, SCREEN_WIDTH, 2, WHITE);

    line= line + 2;
    if (line >= SCREEN_HEIGHT) {
      display.display();
      display.clearDisplay();
      line = 0; // Reset line position if it exceeds screen height
    }
  }
}
